// 'BATTERY_H', 320x14px
const unsigned char epd_bitmap_BATTERY_H [] PROGMEM = {
	0x00, 0x00, 0x00, 0x00, 0x00, 0x00, 0x00, 0x00, 0x00, 0x00, 0x00, 0x00, 0x00, 0x00, 0x00, 0x00, 
	0x00, 0x00, 0x00, 0x00, 0x00, 0x00, 0x00, 0x00, 0x00, 0x00, 0x00, 0x00, 0x00, 0x00, 0x00, 0x00, 
	0x00, 0x00, 0x00, 0x00, 0x00, 0x00, 0x00, 0x00, 0x00, 0x00, 0x00, 0x00, 0x00, 0x00, 0x00, 0x00, 
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	0x00, 0x00, 0x00, 0x00, 0x00, 0x00, 0x00, 0x00, 0x00, 0x00, 0x00, 0x00, 0x00, 0x00, 0x00, 0x00
};
// 'COOLANTTEMP_H', 320x14px
const unsigned char epd_bitmap_COOLANTTEMP_H [] PROGMEM = {
	0x00, 0x00, 0x00, 0x00, 0x00, 0x00, 0x00, 0x00, 0x00, 0x00, 0x00, 0x00, 0x00, 0x00, 0x00, 0x00, 
	0x00, 0x00, 0x00, 0x00, 0x00, 0x00, 0x00, 0x00, 0x00, 0x00, 0x00, 0x00, 0x00, 0x00, 0x00, 0x00, 
	0x00, 0x00, 0x00, 0x00, 0x00, 0x00, 0x00, 0x00, 0x00, 0x00, 0x00, 0x00, 0x00, 0x00, 0x00, 0x00, 
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	0x00, 0x00, 0x00, 0x00, 0x00, 0x00, 0x00, 0x00, 0x00, 0x00, 0x00, 0x00, 0x00, 0x00, 0x00, 0x00
};
// 'ENGINELOAD-H', 320x14px
const unsigned char epd_bitmap_ENGINELOAD_H [] PROGMEM = {
	0x00, 0x00, 0x00, 0x00, 0x00, 0x00, 0x00, 0x00, 0x00, 0x00, 0x00, 0x00, 0x00, 0x00, 0x00, 0x00, 
	0x00, 0x00, 0x00, 0x00, 0x00, 0x00, 0x00, 0x00, 0x00, 0x00, 0x00, 0x00, 0x00, 0x00, 0x00, 0x00, 
	0x00, 0x00, 0x00, 0x00, 0x00, 0x00, 0x00, 0x00, 0x00, 0x00, 0x00, 0x00, 0x00, 0x00, 0x00, 0x00, 
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	0x00, 0x00, 0x00, 0x00, 0x00, 0x00, 0x00, 0x00, 0x00, 0x00, 0x00, 0x00, 0x00, 0x00, 0x00, 0x00
};
// 'ENGINERPM-H', 320x14px
const unsigned char epd_bitmap_ENGINERPM_H [] PROGMEM = {
	0x00, 0x00, 0x00, 0x00, 0x00, 0x00, 0x00, 0x00, 0x00, 0x00, 0x00, 0x00, 0x00, 0x00, 0x00, 0x00, 
	0x00, 0x00, 0x00, 0x00, 0x00, 0x00, 0x00, 0x00, 0x00, 0x00, 0x00, 0x00, 0x00, 0x00, 0x00, 0x00, 
	0x00, 0x00, 0x00, 0x00, 0x00, 0x00, 0x00, 0x00, 0x00, 0x00, 0x00, 0x00, 0x00, 0x00, 0x00, 0x00, 
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	0x00, 0x00, 0x00, 0x00, 0x00, 0x00, 0x00, 0x00, 0x00, 0x00, 0x00, 0x00, 0x00, 0x00, 0x00, 0x00
};
// 'FUEL_RAIL_PRESSURE-H', 320x14px
const unsigned char epd_bitmap_FUEL_RAIL_PRESSURE_H [] PROGMEM = {
	0x00, 0x00, 0x00, 0x00, 0x00, 0x00, 0x00, 0x00, 0x00, 0x00, 0x00, 0x00, 0x00, 0x00, 0x00, 0x00, 
	0x00, 0x00, 0x00, 0x00, 0x00, 0x00, 0x00, 0x00, 0x00, 0x00, 0x00, 0x00, 0x00, 0x00, 0x00, 0x00, 
	0x00, 0x00, 0x00, 0x00, 0x00, 0x00, 0x00, 0x00, 0x00, 0x00, 0x00, 0x00, 0x00, 0x00, 0x00, 0x00, 
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	0x00, 0x00, 0x00, 0x00, 0x00, 0x00, 0x00, 0x00, 0x00, 0x00, 0x00, 0x00, 0x00, 0x00, 0x00, 0x00
};
// 'INTAKE_H', 320x14px
const unsigned char epd_bitmap_INTAKE_H [] PROGMEM = {
	0x00, 0x00, 0x00, 0x00, 0x00, 0x00, 0x00, 0x00, 0x00, 0x00, 0x00, 0x00, 0x00, 0x00, 0x00, 0x00, 
	0x00, 0x00, 0x00, 0x00, 0x00, 0x00, 0x00, 0x00, 0x00, 0x00, 0x00, 0x00, 0x00, 0x00, 0x00, 0x00, 
	0x00, 0x00, 0x00, 0x00, 0x00, 0x00, 0x00, 0x00, 0x00, 0x00, 0x00, 0x00, 0x00, 0x00, 0x00, 0x00, 
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	0x00, 0x00, 0x00, 0x00, 0x00, 0x00, 0x00, 0x00, 0x00, 0x00, 0x00, 0x00, 0x00, 0x00, 0x00, 0x00
};
// 'INTAKEPRES-H', 320x14px
const unsigned char epd_bitmap_INTAKEPRES_H [] PROGMEM = {
	0x00, 0x00, 0x00, 0x00, 0x00, 0x00, 0x00, 0x00, 0x00, 0x00, 0x00, 0x00, 0x00, 0x00, 0x00, 0x00, 
	0x00, 0x00, 0x00, 0x00, 0x00, 0x00, 0x00, 0x00, 0x00, 0x00, 0x00, 0x00, 0x00, 0x00, 0x00, 0x00, 
	0x00, 0x00, 0x00, 0x00, 0x00, 0x00, 0x00, 0x00, 0x00, 0x00, 0x00, 0x00, 0x00, 0x00, 0x00, 0x00, 
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	0x00, 0x00, 0x00, 0x00, 0x00, 0x00, 0x00, 0x00, 0x00, 0x00, 0x00, 0x00, 0x00, 0x00, 0x00, 0x00
};
// 'MAF', 320x14px
const unsigned char epd_bitmap_MAF [] PROGMEM = {
	0x00, 0x00, 0x00, 0x00, 0x00, 0x00, 0x00, 0x00, 0x00, 0x00, 0x00, 0x00, 0x00, 0x00, 0x00, 0x00, 
	0x00, 0x00, 0x00, 0x00, 0x00, 0x00, 0x00, 0x00, 0x00, 0x00, 0x00, 0x00, 0x00, 0x00, 0x00, 0x00, 
	0x00, 0x00, 0x00, 0x00, 0x00, 0x00, 0x00, 0x00, 0x00, 0x00, 0x00, 0x00, 0x00, 0x00, 0x00, 0x00, 
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	0x00, 0x00, 0x00, 0x00, 0x00, 0x00, 0x00, 0x00, 0x00, 0x00, 0x00, 0x00, 0x00, 0x00, 0x00, 0x00
};
// 'VEHICLESPEED-H', 320x14px
const unsigned char epd_bitmap_VEHICLESPEED_H [] PROGMEM = {
	0x00, 0x00, 0x00, 0x00, 0x00, 0x00, 0x00, 0x00, 0x00, 0x00, 0x00, 0x00, 0x00, 0x00, 0x00, 0x00, 
	0x00, 0x00, 0x00, 0x00, 0x00, 0x00, 0x00, 0x00, 0x00, 0x00, 0x00, 0x00, 0x00, 0x00, 0x00, 0x00, 
	0x00, 0x00, 0x00, 0x00, 0x00, 0x00, 0x00, 0x00, 0x00, 0x00, 0x00, 0x00, 0x00, 0x00, 0x00, 0x00, 
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	0x00, 0x00, 0x00, 0x00, 0x00, 0x00, 0x00, 0x00, 0x00, 0x00, 0x00, 0x00, 0x00, 0x00, 0x00, 0x00
};

// Array of all bitmaps for convenience. (Total bytes used to store images in PROGMEM = 5184)
const int epd_bitmap_allArray_LEN = 9;
const unsigned char* epd_bitmap_allArray[9] = {
	epd_bitmap_BATTERY_H,
	epd_bitmap_COOLANTTEMP_H,
	epd_bitmap_ENGINELOAD_H,
	epd_bitmap_ENGINERPM_H,
	epd_bitmap_FUEL_RAIL_PRESSURE_H,
	epd_bitmap_INTAKEPRES_H,
	epd_bitmap_INTAKE_H,
	epd_bitmap_MAF,
	epd_bitmap_VEHICLESPEED_H
};


int numbers1[] = {  
    0, 2, 4, 6, 8, 10, 12, 14, 16, 18, 20, 22, 24, 26, 28, 30, 32, 34, 36, 39, 40,  
    38, 36, 34, 32, 30, 28, 26, 24, 22, 20, 18, 16, 14, 12, 10, 10, 10, 10, 10, 0,  
    0, 0  
};  

int numbers2[] = {  
    10, 12, 14, 16, 18, 20, 22, 24, 26, 28, 30, 29, 28, 27, 26, 25, 24, 23, 22, 21,  
    20, 19, 18, 17, 16, 15, 14, 13, 12, 11, 10, 11, 12, 13, 14, 15, 10, 10, 10, 10,  
    0, 0  
}; 

int numbers3[] = {  
    10, 11, 12, 13, 14, 15, 16, 17, 18, 19, 20, 21, 22, 23, 24, 25, 25, 24, 24, 23,  
    22, 21, 20, 19, 18, 17, 16, 15, 14, 13, 12, 11, 10, 11, 12, 13, 10, 10, 10, 10,  
    0, 0  
};  



#include <SPI.h>
#include <TFT_eSPI.h> 
#include <XPT2046_Touchscreen.h>

TFT_eSPI tft = TFT_eSPI(); 

// Define screen height
#define SCREEN_HEIGHT 240  // Height of the screen in pixels

// Touchscreen pins
#define XPT2046_IRQ 36   // T_IRQ
#define XPT2046_MOSI 13  // T_DIN
#define XPT2046_MISO 12  // T_OUT
#define XPT2046_CLK 14   // T_CLK
#define XPT2046_CS 33    // T_CS

SPIClass touchscreenSPI = SPIClass(HSPI);
XPT2046_Touchscreen touchscreen(XPT2046_CS, XPT2046_IRQ);

int prev_rectWidth1 = 0;
int prev_rectWidth2 = 0;
int prev_rectWidth3 = 0;
// Graph dimensions
const int graphWidth = 320;  // Full width of the display
const int graphHeight = 66;  // Height of the graph area
const int barWidth = 1;      // Width of each bar (1px)

// Arrays to store the heights of the bars for each graph
int barHeights1[graphWidth];  // For the first graph
int barHeights2[graphWidth];  // For the second graph

// Double buffers for each graph
uint16_t buffer1[graphWidth * graphHeight];  // Buffer for the first graph
uint16_t buffer2[graphWidth * graphHeight];  // Buffer for the second graph
int focusIndex = 1;

// Button pin
const int btn1 = 22; 

// Button press duration variables
#define SHORT_PRESS_TIME 500 // 500 milliseconds
#define LONG_PRESS_TIME  1000 // 3000 milliseconds

// Variables for button press logic
int lastState = HIGH;  // the previous state from the input pin
unsigned long pressedTime  = 0;
unsigned long releasedTime = 0;

int section1Mode = 1;
int section2Mode = 1;
int section3Mode = 0;

void setup() {
  Serial.begin(115200);

  // Start the SPI for the touchscreen and init the touchscreen
  touchscreenSPI.begin(XPT2046_CLK, XPT2046_MISO, XPT2046_MOSI, XPT2046_CS);
  touchscreen.begin(touchscreenSPI);
  touchscreen.setRotation(1);

  tft.init();
  tft.setRotation(1); // Landscape mode
  tft.fillScreen(TFT_BLACK); // Clear the screen with black

  // Initialize the barHeights arrays to 0
  InitializeGraph1();

  // Initialize the buffers with black
  InitializeGraph2();

  // Initialize the button pin as input with internal pull-up resistor
  pinMode(btn1, INPUT_PULLUP);
}

void loop() {
  // Simulate data for the graphs
  for (int value = 0; value < 41; value += 1) {
    // Read the button state
    int currentState = digitalRead(btn1);

    // Check for button press
    if (lastState == HIGH && currentState == LOW) { // Button is pressed
      pressedTime = millis();
    } else if (lastState == LOW && currentState == HIGH) { // Button is released
      releasedTime = millis();

      // Calculate press duration
      long pressDuration = releasedTime - pressedTime;

      // Handle short press
      if (pressDuration < SHORT_PRESS_TIME) {
        focusIndex = (focusIndex + 1) % 3;
        Serial.println("Short press detected: Focus index changed");
      }

      // Handle long press
      if (pressDuration > LONG_PRESS_TIME) {
        section1Mode = (section1Mode + 1) % 2;
        tft.fillRect(0, 0, 320, 14, TFT_BLACK);

        section2Mode = (section2Mode + 1) % 2;
        tft.fillRect(0, 80, 320, 14, TFT_BLACK);
        Serial.println("Long press detected: Section modes toggled");
      }
    }

    // Save the current state as the last state
    lastState = currentState;

    // Check for touch input
    if (touchscreen.tirqTouched() && touchscreen.touched()) {
      TS_Point p = touchscreen.getPoint();
      int touchY = map(p.x, 200, 3800, 1, SCREEN_HEIGHT);
      Serial.println(touchY);

      // Determine which section was touched
      if (touchY >= 0 && touchY < 80) {
        focusIndex = 0;
      } else if (touchY >= 80 && touchY < 160) {
        focusIndex = 1;
      } else if (touchY >= 160 && touchY < 240) {
        focusIndex = 2;
      }

      Serial.print("Touch detected: Focus index changed to ");
      Serial.println(focusIndex);
    }

    // Draw graphs based on section modes
    if (section1Mode == 0) {
      drawBar(0, numbers2[value], 1, focusIndex == 0, 0, 45, 1);
    } else {
      drawGraph(0, numbers2[value], 5, barHeights1, buffer1, focusIndex == 0, 0, 70);
    }

    if (section2Mode == 0) {
      drawBar(80, numbers1[value], 1, focusIndex == 1, 0, 45, 2);
    } else {
      drawGraph(80, numbers1[value], 5, barHeights2, buffer2, focusIndex == 1, 0, 70);
    }

    drawBar(160, numbers1[value], 3, focusIndex == 2, 0, 45, 3);

    delay(50); 
  }
}

void drawBar(int y, int value, int header, bool focus, int max_value, int min_value, int section) {
  tft.drawBitmap(0, y, epd_bitmap_allArray[header], 320, 14, TFT_WHITE);

  int rectWidth = map(value, 0, 45, 0, 320);

  if (section == 1) {
    if (rectWidth != prev_rectWidth1) {
      tft.fillRect(0 + prev_rectWidth1, y + 14, 320 - prev_rectWidth1, 66, TFT_BLACK);
      tft.fillRect(0, y + 14, rectWidth, 66, TFT_WHITE);
      prev_rectWidth1 = rectWidth;
    }
  }

  if (section == 2) {
    if (rectWidth != prev_rectWidth2) {
      tft.fillRect(0 + prev_rectWidth2, y + 14, 320 - prev_rectWidth2, 66, TFT_BLACK);
      tft.fillRect(0, y + 14, rectWidth, 66, TFT_WHITE);
      prev_rectWidth2 = rectWidth;
    }
  }

    if (section == 3) {
    if (rectWidth != prev_rectWidth3) {
      tft.fillRect(0 + prev_rectWidth3, y + 14, 320 - prev_rectWidth3, 66, TFT_BLACK);
      tft.fillRect(0, y + 14, rectWidth, 66, TFT_WHITE);
      prev_rectWidth3 = rectWidth;
    }
  }

  tft.setTextColor(TFT_WHITE, TFT_BLACK); 
  tft.setTextSize(2); 

  tft.fillRect(289, y + 2, 50, 20, TFT_BLACK); 

  tft.setCursor(289, y + 2); 
  tft.print(value); 

  if (focus) {
    drawFocus(y);
  } else {
    tft.drawRect(0, y, 320, 80, TFT_BLACK);
  }
}

void drawGraph(int y, int value, int header, int barHeights[], uint16_t buffer[], bool focus, int max_value, int min_value) {
  tft.drawBitmap(0, y, epd_bitmap_allArray[header], 320, 14, TFT_WHITE);

  y = y + 14;

  // Shift all bars to the left by 1px
  for (int i = 0; i < graphWidth - 1; i++) {
    barHeights[i] = barHeights[i + 1];
  }

  // Add a new bar at the rightmost position
  int newBarHeight = 0; // Default to 0 height
  if (value != 0) { // Only map if the value is not 0
    newBarHeight = map(value, min_value, max_value, 0, graphHeight);  // Scale value to graph height
  }

  barHeights[graphWidth - 1] = newBarHeight;

  // Clear the buffer (fill with black)
  for (int i = 0; i < graphWidth * graphHeight; i++) {
    buffer[i] = TFT_BLACK;
  }

  // Draw each bar in the buffer
  for (int x = 0; x < graphWidth; x++) {
    int barHeight = barHeights[x];
    if (barHeight > 0) {
      for (int y = graphHeight - barHeight; y < graphHeight; y++) {
        buffer[y * graphWidth + x] = TFT_WHITE;  // Draw a vertical line
      }
    }
  }

  // Copy the buffer to the display at the specified y
  tft.pushImage(0, y, graphWidth, graphHeight, buffer);

  // Draw the value value in number form
  tft.setTextColor(TFT_WHITE, TFT_BLACK); // White text on black background
  tft.setTextSize(2); // Larger text size for better visibility

  // Clear the previous text by drawing a black rectangle over it
  tft.fillRect(289, y - 12, 50, 20, TFT_BLACK); // Adjust size based on text size

  // Set the cursor position explicitly before printing
  tft.setCursor(289, y - 12); // Set the cursor position
  tft.print(value); // Print the value value

  if (focus) {
    drawFocus(y - 14);
  } else {
    tft.drawRect(0, y - 14, 320, 80, TFT_BLACK);
  }
}

void drawFocus(int y) {
  tft.drawRect(0, y, 320, 80, TFT_ORANGE);
}

void InitializeGraph1() {
  for (int i = 0; i < graphWidth; i++) {
    barHeights1[i] = 0;
  }

  for (int i = 0; i < graphWidth * graphHeight; i++) {
    buffer1[i] = TFT_BLACK;
  }
}

void InitializeGraph2() {
  for (int i = 0; i < graphWidth; i++) {
    barHeights2[i] = 0;
  }

  for (int i = 0; i < graphWidth * graphHeight; i++) {
    buffer2[i] = TFT_BLACK;
  }
}